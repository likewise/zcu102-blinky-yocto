## build/conf/bblayers.conf
```bitbake
# POKY_BBLAYERS_CONF_VERSION is increased each time build/conf/bblayers.conf
# changes incompatibly
POKY_BBLAYERS_CONF_VERSION = "2"

BBPATH = "${TOPDIR}"
BBFILES ?= ""

BBLAYERS ?= " \
  /home/leon/sandbox/parretto/zcu102-yocto/poky/meta \
  /home/leon/sandbox/parretto/zcu102-yocto/poky/meta-poky \
  /home/leon/sandbox/parretto/zcu102-yocto/poky/meta-yocto-bsp \
  /home/leon/sandbox/parretto/zcu102-yocto/meta-openembedded/meta-oe \
  /home/leon/sandbox/parretto/zcu102-yocto/meta-openembedded/meta-python \
  /home/leon/sandbox/parretto/zcu102-yocto/meta-xilinx/meta-xilinx-bsp \
  /home/leon/sandbox/parretto/zcu102-yocto/meta-xilinx/meta-xilinx-contrib \
  /home/leon/sandbox/parretto/zcu102-yocto/meta-xilinx/meta-xilinx-standalone \
  /home/leon/sandbox/parretto/zcu102-yocto/meta-xilinx-tools \
  /home/leon/sandbox/parretto/zcu102-yocto/meta-project \
"
```

## meta-project/conf/layer.conf
```bitbake
# We have a conf and classes directory, add to BBPATH
BBPATH .= ":${LAYERDIR}"

# We have recipes-* directories, add to BBFILES
BBFILES += "${LAYERDIR}/recipes-*/*/*.bb \
	${LAYERDIR}/recipes-*/*/*.bbappend"

BBFILE_COLLECTIONS += "project"
BBFILE_PATTERN_project = "^${LAYERDIR}/"
BBFILE_PRIORITY_project = "1"

LAYERVERSION_fixes = "5"
LAYERSERIES_COMPAT_project = "gatesgarth"
```

## meta-project/recipes-bsp/u-boot/u-boot-zynq-scr/boot.scr.its
```
/dts-v1/;
 
/ {
    description = "Boot script";
    images {
         default = "script";
         script {
             description = "Boot script";
             data = /incbin/("./boot.cmd");
             type = "script";
             compression = "none";
             hash {
                 algo = "sha1";
             };
        };
    };
};
```
